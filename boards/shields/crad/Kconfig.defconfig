## boards/shields/crad/Kconfig.defconfig
```kconfig
# Copyright (c) 2020 The ZMK Contributors
# SPDX-License-Identifier: MIT

if SHIELD_CRAD_LEFT

config ZMK_KEYBOARD_NAME
    default "Crad"

config ZMK_SPLIT_ROLE_CENTRAL
    default y

endif

if SHIELD_CRAD_LEFT || SHIELD_CRAD_RIGHT

config ZMK_SPLIT
    default y

endif
```

## boards/shields/crad/Kconfig.shield
```kconfig
# Copyright (c) 2020 The ZMK Contributors
# SPDX-License-Identifier: MIT

config SHIELD_CRAD_LEFT
    def_bool $(shields_list_contains,crad_left)

config SHIELD_CRAD_RIGHT
    def_bool $(shields_list_contains,crad_right)
```

## boards/shields/demeter/Kconfig.defconfig
```kconfig
# Copyright (c) 2020 The ZMK Contributors
# SPDX-License-Identifier: MIT

if SHIELD_DEMETER_LEFT

config ZMK_KEYBOARD_NAME
    default "Demeter"

config ZMK_SPLIT_ROLE_CENTRAL
    default y

endif

if SHIELD_DEMETER_LEFT || SHIELD_DEMETER_RIGHT

config ZMK_SPLIT
    default y

endif
```

## boards/shields/demeter/Kconfig.shield
```kconfig
# Copyright (c) 2020 The ZMK Contributors
# SPDX-License-Identifier: MIT

config SHIELD_DEMETER_LEFT
    def_bool $(shields_list_contains,demeter_left)

config SHIELD_DEMETER_RIGHT
    def_bool $(shields_list_contains,demeter_right)
```
